## build/lsm303agr/Kconfig/soc/Kconfig
```kconfig
# Load Zephyr SoC Kconfig descriptions.
osource "/Users/naray/nordicsdks/zephyr/soc/xlnx/zynqmp/Kconfig"
osource "/Users/naray/nordicsdks/zephyr/soc/xlnx/zynq7000/Kconfig"
osource "/Users/naray/nordicsdks/zephyr/soc/xen/Kconfig"
osource "/Users/naray/nordicsdks/zephyr/soc/wch/ch32v00x/Kconfig"
osource "/Users/naray/nordicsdks/zephyr/soc/ti/simplelink/Kconfig"
osource "/Users/naray/nordicsdks/zephyr/soc/ti/lm3s6965/Kconfig"
osource "/Users/naray/nordicsdks/zephyr/soc/ti/k3/Kconfig"
osource "/Users/naray/nordicsdks/zephyr/soc/telink/tlsr/Kconfig"
osource "/Users/naray/nordicsdks/zephyr/soc/starfive/jh71xx/Kconfig"
osource "/Users/naray/nordicsdks/zephyr/soc/st/stm32/Kconfig"
osource "/Users/naray/nordicsdks/zephyr/soc/snps/qemu_arc/Kconfig"
osource "/Users/naray/nordicsdks/zephyr/soc/snps/nsim/arc_v/Kconfig"
osource "/Users/naray/nordicsdks/zephyr/soc/snps/nsim/arc_classic/Kconfig"
osource "/Users/naray/nordicsdks/zephyr/soc/snps/hsdk4xd/Kconfig"
osource "/Users/naray/nordicsdks/zephyr/soc/snps/hsdk/Kconfig"
osource "/Users/naray/nordicsdks/zephyr/soc/snps/emsk/Kconfig"
osource "/Users/naray/nordicsdks/zephyr/soc/snps/emsdp/Kconfig"
osource "/Users/naray/nordicsdks/zephyr/soc/snps/arc_iot/Kconfig"
osource "/Users/naray/nordicsdks/zephyr/soc/silabs/Kconfig"
osource "/Users/naray/nordicsdks/zephyr/soc/sifive/sifive_freedom/Kconfig"
osource "/Users/naray/nordicsdks/zephyr/soc/sensry/Kconfig"
osource "/Users/naray/nordicsdks/zephyr/soc/rockchip/Kconfig"
osource "/Users/naray/nordicsdks/zephyr/soc/renode/riscv_virtual/Kconfig"
osource "/Users/naray/nordicsdks/zephyr/soc/renode/cortex_r8_virtual/Kconfig"
osource "/Users/naray/nordicsdks/zephyr/soc/renesas/smartbond/Kconfig"
osource "/Users/naray/nordicsdks/zephyr/soc/renesas/rzt2m/Kconfig"
osource "/Users/naray/nordicsdks/zephyr/soc/renesas/rz/Kconfig"
osource "/Users/naray/nordicsdks/zephyr/soc/renesas/rcar/Kconfig"
osource "/Users/naray/nordicsdks/zephyr/soc/renesas/ra/Kconfig"
osource "/Users/naray/nordicsdks/zephyr/soc/realtek/ec/Kconfig"
osource "/Users/naray/nordicsdks/zephyr/soc/raspberrypi/rpi_pico/Kconfig"
osource "/Users/naray/nordicsdks/zephyr/soc/quicklogic/eos_s3/Kconfig"
osource "/Users/naray/nordicsdks/zephyr/soc/qemu/virt_riscv/Kconfig"
osource "/Users/naray/nordicsdks/zephyr/soc/qemu/malta/Kconfig"
osource "/Users/naray/nordicsdks/zephyr/soc/openisa/rv32m1/Kconfig"
osource "/Users/naray/nordicsdks/zephyr/soc/nxp/s32/Kconfig"
osource "/Users/naray/nordicsdks/zephyr/soc/nxp/rw/Kconfig"
osource "/Users/naray/nordicsdks/zephyr/soc/nxp/mcx/Kconfig"
osource "/Users/naray/nordicsdks/zephyr/soc/nxp/lpc/Kconfig"
osource "/Users/naray/nordicsdks/zephyr/soc/nxp/layerscape/Kconfig"
osource "/Users/naray/nordicsdks/zephyr/soc/nxp/kinetis/Kconfig"
osource "/Users/naray/nordicsdks/zephyr/soc/nxp/imxrt/Kconfig"
osource "/Users/naray/nordicsdks/zephyr/soc/nxp/imx/Kconfig"
osource "/Users/naray/nordicsdks/zephyr/soc/nuvoton/numicro/Kconfig"
osource "/Users/naray/nordicsdks/zephyr/soc/nuvoton/numaker/Kconfig"
osource "/Users/naray/nordicsdks/zephyr/soc/nuvoton/npcx/Kconfig"
osource "/Users/naray/nordicsdks/zephyr/soc/nuvoton/npcm/Kconfig"
osource "/Users/naray/nordicsdks/zephyr/soc/nordic/Kconfig"
osource "/Users/naray/nordicsdks/zephyr/soc/neorv32/Kconfig"
osource "/Users/naray/nordicsdks/zephyr/soc/native/inf_clock/Kconfig"
osource "/Users/naray/nordicsdks/zephyr/soc/microchip/miv/Kconfig"
osource "/Users/naray/nordicsdks/zephyr/soc/microchip/mec/Kconfig"
osource "/Users/naray/nordicsdks/zephyr/soc/mediatek/mt8xxx/Kconfig"
osource "/Users/naray/nordicsdks/zephyr/soc/lowrisc/opentitan/Kconfig"
osource "/Users/naray/nordicsdks/zephyr/soc/litex/litex_vexriscv/Kconfig"
osource "/Users/naray/nordicsdks/zephyr/soc/ite/ec/Kconfig"
osource "/Users/naray/nordicsdks/zephyr/soc/intel/raptor_lake/Kconfig"
osource "/Users/naray/nordicsdks/zephyr/soc/intel/lakemont/Kconfig"
osource "/Users/naray/nordicsdks/zephyr/soc/intel/intel_socfpga_std/Kconfig"
osource "/Users/naray/nordicsdks/zephyr/soc/intel/intel_socfpga/Kconfig"
osource "/Users/naray/nordicsdks/zephyr/soc/intel/intel_niosv/Kconfig"
osource "/Users/naray/nordicsdks/zephyr/soc/intel/intel_ish/Kconfig"
osource "/Users/naray/nordicsdks/zephyr/soc/intel/intel_adsp/Kconfig"
osource "/Users/naray/nordicsdks/zephyr/soc/intel/elkhart_lake/Kconfig"
osource "/Users/naray/nordicsdks/zephyr/soc/intel/atom/Kconfig"
osource "/Users/naray/nordicsdks/zephyr/soc/intel/apollo_lake/Kconfig"
osource "/Users/naray/nordicsdks/zephyr/soc/intel/alder_lake/Kconfig"
osource "/Users/naray/nordicsdks/zephyr/soc/infineon/cat3/Kconfig"
osource "/Users/naray/nordicsdks/zephyr/soc/infineon/cat1b/Kconfig"
osource "/Users/naray/nordicsdks/zephyr/soc/infineon/cat1a/Kconfig"
osource "/Users/naray/nordicsdks/zephyr/soc/gd/gd32/Kconfig"
osource "/Users/naray/nordicsdks/zephyr/soc/gaisler/leon3/Kconfig"
osource "/Users/naray/nordicsdks/zephyr/soc/gaisler/gr716a/Kconfig"
osource "/Users/naray/nordicsdks/zephyr/soc/espressif/Kconfig"
osource "/Users/naray/nordicsdks/zephyr/soc/ene/kb1200/Kconfig"
osource "/Users/naray/nordicsdks/zephyr/soc/efinix/sapphire/Kconfig"
osource "/Users/naray/nordicsdks/zephyr/soc/cdns/xtensa_sample_controller/Kconfig"
osource "/Users/naray/nordicsdks/zephyr/soc/cdns/sample_controller32/Kconfig"
osource "/Users/naray/nordicsdks/zephyr/soc/cdns/dc233c/Kconfig"
osource "/Users/naray/nordicsdks/zephyr/soc/brcm/bcmvk/Kconfig"
osource "/Users/naray/nordicsdks/zephyr/soc/brcm/bcm2712/Kconfig"
osource "/Users/naray/nordicsdks/zephyr/soc/brcm/bcm2711/Kconfig"
osource "/Users/naray/nordicsdks/zephyr/soc/atmel/sam0/Kconfig"
osource "/Users/naray/nordicsdks/zephyr/soc/atmel/sam/Kconfig"
osource "/Users/naray/nordicsdks/zephyr/soc/aspeed/Kconfig"
osource "/Users/naray/nordicsdks/zephyr/soc/arm/Kconfig"
osource "/Users/naray/nordicsdks/zephyr/soc/arm/beetle/Kconfig"
osource "/Users/naray/nordicsdks/zephyr/soc/andestech/Kconfig"
osource "/Users/naray/nordicsdks/zephyr/soc/amd/acp_6_0/Kconfig"
osource "/Users/naray/nordicsdks/zephyr/soc/ambiq/Kconfig"
osource "/Users/naray/nordicsdks/zephyr/soc/altr/zephyr_nios2f/Kconfig"
osource "/Users/naray/nordicsdks/zephyr/soc/altr/qemu_nios2/Kconfig"
osource "/Users/naray/nordicsdks/zephyr/soc/adi/max32/Kconfig"
osource "/Users/naray/nordicsdks/nrf/soc/nordic/Kconfig"
```

## build/lsm303agr_embedded/Kconfig/arch/Kconfig
```kconfig
# Load Zephyr Arch Kconfig descriptions.
osource "/Users/naray/nordicsdks/zephyr/arch/x86/Kconfig"
osource "/Users/naray/nordicsdks/zephyr/arch/xtensa/Kconfig"
osource "/Users/naray/nordicsdks/zephyr/arch/sparc/Kconfig"
osource "/Users/naray/nordicsdks/zephyr/arch/riscv/Kconfig"
osource "/Users/naray/nordicsdks/zephyr/arch/posix/Kconfig"
osource "/Users/naray/nordicsdks/zephyr/arch/nios2/Kconfig"
osource "/Users/naray/nordicsdks/zephyr/arch/mips/Kconfig"
osource "/Users/naray/nordicsdks/zephyr/arch/arm64/Kconfig"
osource "/Users/naray/nordicsdks/zephyr/arch/arm/Kconfig"
osource "/Users/naray/nordicsdks/zephyr/arch/arc/Kconfig"
```

## build/lsm303agr_embedded/Kconfig/boards/Kconfig.defconfig
```kconfig
# Load Zephyr board defconfig descriptions.
osource "/Users/naray/nordicsdks/zephyr/boards/nordic/nrf52833dk/Kconfig.defconfig"
```

## build/lsm303agr_embedded/Kconfig/boards/Kconfig.sysbuild
```kconfig
# Load Sysbuild board Kconfig descriptions.
osource "/Users/naray/nordicsdks/zephyr/boards/nordic/nrf52833dk/Kconfig.sysbuild"
```
