## build/Kconfig/Kconfig.modules
```kconfig
menu "nrf (/Users/naray/nordicsdks/nrf)"
osource "/Users/naray/nordicsdks/nrf/Kconfig.nrf"
config ZEPHYR_NRF_MODULE
	bool
	default y
endmenu
menu "hostap (/Users/naray/nordicsdks/modules/lib/hostap)"
osource "$(ZEPHYR_HOSTAP_KCONFIG)"
config ZEPHYR_HOSTAP_MODULE
	bool
	default y
endmenu
menu "mcuboot (/Users/naray/nordicsdks/bootloader/mcuboot)"
osource "$(ZEPHYR_MCUBOOT_KCONFIG)"
config ZEPHYR_MCUBOOT_MODULE
	bool
	default y
endmenu
menu "mbedtls (/Users/naray/nordicsdks/modules/crypto/mbedtls)"
osource "$(ZEPHYR_MBEDTLS_KCONFIG)"
config ZEPHYR_MBEDTLS_MODULE
	bool
	default y
endmenu
menu "oberon-psa-crypto (/Users/naray/nordicsdks/modules/crypto/oberon-psa-crypto)"
osource "/Users/naray/nordicsdks/modules/crypto/oberon-psa-crypto/Kconfig.oberon_psa_crypto"
config ZEPHYR_OBERON_PSA_CRYPTO_MODULE
	bool
	default y
endmenu
menu "trusted-firmware-m (/Users/naray/nordicsdks/modules/tee/tf-m/trusted-firmware-m)"
osource "$(ZEPHYR_TRUSTED_FIRMWARE_M_KCONFIG)"
config ZEPHYR_TRUSTED_FIRMWARE_M_MODULE
	bool
	default y
endmenu
config ZEPHYR_PSA_ARCH_TESTS_MODULE
	bool
	default y
menu "cjson (/Users/naray/nordicsdks/modules/lib/cjson)"
osource "$(ZEPHYR_CJSON_KCONFIG)"
config ZEPHYR_CJSON_MODULE
	bool
	default y
endmenu
menu "azure-sdk-for-c (/Users/naray/nordicsdks/modules/lib/azure-sdk-for-c)"
osource "$(ZEPHYR_AZURE_SDK_FOR_C_KCONFIG)"
config ZEPHYR_AZURE_SDK_FOR_C_MODULE
	bool
	default y
endmenu
menu "cirrus-logic (/Users/naray/nordicsdks/modules/hal/cirrus-logic)"
osource "/Users/naray/nordicsdks/modules/hal/cirrus-logic/Kconfig"
config ZEPHYR_CIRRUS_LOGIC_MODULE
	bool
	default y
endmenu
menu "openthread (/Users/naray/nordicsdks/modules/lib/openthread)"
osource "$(ZEPHYR_OPENTHREAD_KCONFIG)"
config ZEPHYR_OPENTHREAD_MODULE
	bool
	default y
endmenu
menu "suit-generator (/Users/naray/nordicsdks/modules/lib/suit-generator)"
osource "/Users/naray/nordicsdks/modules/lib/suit-generator/ncs/Kconfig"
config ZEPHYR_SUIT_GENERATOR_MODULE
	bool
	default y
endmenu
menu "suit-processor (/Users/naray/nordicsdks/modules/lib/suit-processor)"
osource "/Users/naray/nordicsdks/modules/lib/suit-processor/Kconfig"
config ZEPHYR_SUIT_PROCESSOR_MODULE
	bool
	default y
endmenu
menu "memfault-firmware-sdk (/Users/naray/nordicsdks/modules/lib/memfault-firmware-sdk)"
osource "/Users/naray/nordicsdks/modules/lib/memfault-firmware-sdk/ports/zephyr/Kconfig"
config ZEPHYR_MEMFAULT_FIRMWARE_SDK_MODULE
	bool
	default y
endmenu
menu "coremark (/Users/naray/nordicsdks/modules/benchmark/coremark)"
osource "$(ZEPHYR_COREMARK_KCONFIG)"
config ZEPHYR_COREMARK_MODULE
	bool
	default y
endmenu
menu "canopennode (/Users/naray/nordicsdks/modules/lib/canopennode)"
osource "$(ZEPHYR_CANOPENNODE_KCONFIG)"
config ZEPHYR_CANOPENNODE_MODULE
	bool
	default y
endmenu
menu "chre (/Users/naray/nordicsdks/modules/lib/chre)"
osource "/Users/naray/nordicsdks/modules/lib/chre/platform/zephyr/Kconfig"
config ZEPHYR_CHRE_MODULE
	bool
	default y
endmenu
menu "lz4 (/Users/naray/nordicsdks/modules/lib/lz4)"
osource "$(ZEPHYR_LZ4_KCONFIG)"
config ZEPHYR_LZ4_MODULE
	bool
	default y
endmenu
menu "nanopb (/Users/naray/nordicsdks/modules/lib/nanopb)"
osource "$(ZEPHYR_NANOPB_KCONFIG)"
config ZEPHYR_NANOPB_MODULE
	bool
	default y
endmenu
config ZEPHYR_TF_M_TESTS_MODULE
	bool
	default y
menu "zscilib (/Users/naray/nordicsdks/modules/lib/zscilib)"
osource "/Users/naray/nordicsdks/modules/lib/zscilib/Kconfig.zscilib"
config ZEPHYR_ZSCILIB_MODULE
	bool
	default y
endmenu
menu "cmsis (/Users/naray/nordicsdks/modules/hal/cmsis)"
osource "$(ZEPHYR_CMSIS_KCONFIG)"
config ZEPHYR_CMSIS_MODULE
	bool
	default y
endmenu
menu "cmsis-dsp (/Users/naray/nordicsdks/modules/lib/cmsis-dsp)"
osource "$(ZEPHYR_CMSIS_DSP_KCONFIG)"
config ZEPHYR_CMSIS_DSP_MODULE
	bool
	default y
endmenu
menu "cmsis-nn (/Users/naray/nordicsdks/modules/lib/cmsis-nn)"
osource "$(ZEPHYR_CMSIS_NN_KCONFIG)"
config ZEPHYR_CMSIS_NN_MODULE
	bool
	default y
endmenu
menu "fatfs (/Users/naray/nordicsdks/modules/fs/fatfs)"
osource "$(ZEPHYR_FATFS_KCONFIG)"
config ZEPHYR_FATFS_MODULE
	bool
	default y
endmenu
menu "hal_nordic (/Users/naray/nordicsdks/modules/hal/nordic)"
osource "$(ZEPHYR_HAL_NORDIC_KCONFIG)"
config ZEPHYR_HAL_NORDIC_MODULE
	bool
	default y

config ZEPHYR_HAL_NORDIC_MODULE_BLOBS
	bool
endmenu
menu "hal_st (/Users/naray/nordicsdks/modules/hal/st)"
osource "$(ZEPHYR_HAL_ST_KCONFIG)"
config ZEPHYR_HAL_ST_MODULE
	bool
	default y
endmenu
menu "hal_tdk (/Users/naray/nordicsdks/modules/hal/tdk)"
osource "$(ZEPHYR_HAL_TDK_KCONFIG)"
config ZEPHYR_HAL_TDK_MODULE
	bool
	default y
endmenu
config ZEPHYR_HAL_WURTHELEKTRONIK_MODULE
	bool
	default y
menu "liblc3 (/Users/naray/nordicsdks/modules/lib/liblc3)"
osource "$(ZEPHYR_LIBLC3_KCONFIG)"
config ZEPHYR_LIBLC3_MODULE
	bool
	default y
endmenu
config ZEPHYR_LIBMETAL_MODULE
	bool
	default y
menu "littlefs (/Users/naray/nordicsdks/modules/fs/littlefs)"
osource "$(ZEPHYR_LITTLEFS_KCONFIG)"
config ZEPHYR_LITTLEFS_MODULE
	bool
	default y
endmenu
menu "loramac-node (/Users/naray/nordicsdks/modules/lib/loramac-node)"
osource "$(ZEPHYR_LORAMAC_NODE_KCONFIG)"
config ZEPHYR_LORAMAC_NODE_MODULE
	bool
	default y
endmenu
menu "lvgl (/Users/naray/nordicsdks/modules/lib/gui/lvgl)"
osource "/Users/naray/nordicsdks/modules/lib/gui/lvgl/zephyr/Kconfig"
config ZEPHYR_LVGL_MODULE
	bool
	default y
endmenu
config ZEPHYR_MIPI_SYS_T_MODULE
	bool
	default y
menu "nrf_wifi (/Users/naray/nordicsdks/modules/lib/nrf_wifi)"
osource "$(ZEPHYR_NRF_WIFI_KCONFIG)"
config ZEPHYR_NRF_WIFI_MODULE
	bool
	default y

config ZEPHYR_NRF_WIFI_MODULE_BLOBS
	bool
endmenu
config ZEPHYR_OPEN_AMP_MODULE
	bool
	default y
menu "percepio (/Users/naray/nordicsdks/modules/debug/percepio)"
osource "/Users/naray/nordicsdks/modules/debug/percepio/zephyr/Kconfig"
config ZEPHYR_PERCEPIO_MODULE
	bool
	default y
endmenu
menu "picolibc (/Users/naray/nordicsdks/modules/lib/picolibc)"
osource "/Users/naray/nordicsdks/modules/lib/picolibc/zephyr/Kconfig"
config ZEPHYR_PICOLIBC_MODULE
	bool
	default y
endmenu
menu "segger (/Users/naray/nordicsdks/modules/debug/segger)"
osource "$(ZEPHYR_SEGGER_KCONFIG)"
config ZEPHYR_SEGGER_MODULE
	bool
	default y
endmenu
config ZEPHYR_TINYCRYPT_MODULE
	bool
	default y
menu "uoscore-uedhoc (/Users/naray/nordicsdks/modules/lib/uoscore-uedhoc)"
osource "$(ZEPHYR_UOSCORE_UEDHOC_KCONFIG)"
config ZEPHYR_UOSCORE_UEDHOC_MODULE
	bool
	default y
endmenu
menu "zcbor (/Users/naray/nordicsdks/modules/lib/zcbor)"
osource "$(ZEPHYR_ZCBOR_KCONFIG)"
config ZEPHYR_ZCBOR_MODULE
	bool
	default y
endmenu
menu "nrfxlib (/Users/naray/nordicsdks/nrfxlib)"
osource "/Users/naray/nordicsdks/nrfxlib/Kconfig.nrfxlib"
config ZEPHYR_NRFXLIB_MODULE
	bool
	default y
endmenu
config ZEPHYR_NRF_HW_MODELS_MODULE
	bool
	default y
menu "connectedhomeip (/Users/naray/nordicsdks/modules/lib/matter)"
osource "/Users/naray/nordicsdks/modules/lib/matter/config/nrfconnect/chip-module/Kconfig"
config ZEPHYR_CONNECTEDHOMEIP_MODULE
	bool
	default y
endmenu
```

## build/Kconfig/soc/Kconfig.soc
```kconfig
# Load SoC Kconfig descriptions.
osource "/Users/naray/nordicsdks/zephyr/soc/xlnx/zynqmp/Kconfig.soc"
osource "/Users/naray/nordicsdks/zephyr/soc/xlnx/zynq7000/Kconfig.soc"
osource "/Users/naray/nordicsdks/zephyr/soc/xen/Kconfig.soc"
osource "/Users/naray/nordicsdks/zephyr/soc/wch/ch32v00x/Kconfig.soc"
osource "/Users/naray/nordicsdks/zephyr/soc/ti/simplelink/Kconfig.soc"
osource "/Users/naray/nordicsdks/zephyr/soc/ti/lm3s6965/Kconfig.soc"
osource "/Users/naray/nordicsdks/zephyr/soc/ti/k3/Kconfig.soc"
osource "/Users/naray/nordicsdks/zephyr/soc/telink/tlsr/Kconfig.soc"
osource "/Users/naray/nordicsdks/zephyr/soc/starfive/jh71xx/Kconfig.soc"
osource "/Users/naray/nordicsdks/zephyr/soc/st/stm32/Kconfig.soc"
osource "/Users/naray/nordicsdks/zephyr/soc/snps/qemu_arc/Kconfig.soc"
osource "/Users/naray/nordicsdks/zephyr/soc/snps/nsim/arc_v/Kconfig.soc"
osource "/Users/naray/nordicsdks/zephyr/soc/snps/nsim/arc_classic/Kconfig.soc"
osource "/Users/naray/nordicsdks/zephyr/soc/snps/hsdk4xd/Kconfig.soc"
osource "/Users/naray/nordicsdks/zephyr/soc/snps/hsdk/Kconfig.soc"
osource "/Users/naray/nordicsdks/zephyr/soc/snps/emsk/Kconfig.soc"
osource "/Users/naray/nordicsdks/zephyr/soc/snps/emsdp/Kconfig.soc"
osource "/Users/naray/nordicsdks/zephyr/soc/snps/arc_iot/Kconfig.soc"
osource "/Users/naray/nordicsdks/zephyr/soc/silabs/Kconfig.soc"
osource "/Users/naray/nordicsdks/zephyr/soc/sifive/sifive_freedom/Kconfig.soc"
osource "/Users/naray/nordicsdks/zephyr/soc/sensry/Kconfig.soc"
osource "/Users/naray/nordicsdks/zephyr/soc/rockchip/Kconfig.soc"
osource "/Users/naray/nordicsdks/zephyr/soc/renode/riscv_virtual/Kconfig.soc"
osource "/Users/naray/nordicsdks/zephyr/soc/renode/cortex_r8_virtual/Kconfig.soc"
osource "/Users/naray/nordicsdks/zephyr/soc/renesas/smartbond/Kconfig.soc"
osource "/Users/naray/nordicsdks/zephyr/soc/renesas/rzt2m/Kconfig.soc"
osource "/Users/naray/nordicsdks/zephyr/soc/renesas/rz/Kconfig.soc"
osource "/Users/naray/nordicsdks/zephyr/soc/renesas/rcar/Kconfig.soc"
osource "/Users/naray/nordicsdks/zephyr/soc/renesas/ra/Kconfig.soc"
osource "/Users/naray/nordicsdks/zephyr/soc/realtek/ec/Kconfig.soc"
osource "/Users/naray/nordicsdks/zephyr/soc/raspberrypi/rpi_pico/Kconfig.soc"
osource "/Users/naray/nordicsdks/zephyr/soc/quicklogic/eos_s3/Kconfig.soc"
osource "/Users/naray/nordicsdks/zephyr/soc/qemu/virt_riscv/Kconfig.soc"
osource "/Users/naray/nordicsdks/zephyr/soc/qemu/malta/Kconfig.soc"
osource "/Users/naray/nordicsdks/zephyr/soc/openisa/rv32m1/Kconfig.soc"
osource "/Users/naray/nordicsdks/zephyr/soc/nxp/s32/Kconfig.soc"
osource "/Users/naray/nordicsdks/zephyr/soc/nxp/rw/Kconfig.soc"
osource "/Users/naray/nordicsdks/zephyr/soc/nxp/mcx/Kconfig.soc"
osource "/Users/naray/nordicsdks/zephyr/soc/nxp/lpc/Kconfig.soc"
osource "/Users/naray/nordicsdks/zephyr/soc/nxp/layerscape/Kconfig.soc"
osource "/Users/naray/nordicsdks/zephyr/soc/nxp/kinetis/Kconfig.soc"
osource "/Users/naray/nordicsdks/zephyr/soc/nxp/imxrt/Kconfig.soc"
osource "/Users/naray/nordicsdks/zephyr/soc/nxp/imx/Kconfig.soc"
osource "/Users/naray/nordicsdks/zephyr/soc/nuvoton/numicro/Kconfig.soc"
osource "/Users/naray/nordicsdks/zephyr/soc/nuvoton/numaker/Kconfig.soc"
osource "/Users/naray/nordicsdks/zephyr/soc/nuvoton/npcx/Kconfig.soc"
osource "/Users/naray/nordicsdks/zephyr/soc/nuvoton/npcm/Kconfig.soc"
osource "/Users/naray/nordicsdks/zephyr/soc/nordic/Kconfig.soc"
osource "/Users/naray/nordicsdks/zephyr/soc/neorv32/Kconfig.soc"
osource "/Users/naray/nordicsdks/zephyr/soc/native/inf_clock/Kconfig.soc"
osource "/Users/naray/nordicsdks/zephyr/soc/microchip/miv/Kconfig.soc"
osource "/Users/naray/nordicsdks/zephyr/soc/microchip/mec/Kconfig.soc"
osource "/Users/naray/nordicsdks/zephyr/soc/mediatek/mt8xxx/Kconfig.soc"
osource "/Users/naray/nordicsdks/zephyr/soc/lowrisc/opentitan/Kconfig.soc"
osource "/Users/naray/nordicsdks/zephyr/soc/litex/litex_vexriscv/Kconfig.soc"
osource "/Users/naray/nordicsdks/zephyr/soc/ite/ec/Kconfig.soc"
osource "/Users/naray/nordicsdks/zephyr/soc/intel/raptor_lake/Kconfig.soc"
osource "/Users/naray/nordicsdks/zephyr/soc/intel/lakemont/Kconfig.soc"
osource "/Users/naray/nordicsdks/zephyr/soc/intel/intel_socfpga_std/Kconfig.soc"
osource "/Users/naray/nordicsdks/zephyr/soc/intel/intel_socfpga/Kconfig.soc"
osource "/Users/naray/nordicsdks/zephyr/soc/intel/intel_niosv/Kconfig.soc"
osource "/Users/naray/nordicsdks/zephyr/soc/intel/intel_ish/Kconfig.soc"
osource "/Users/naray/nordicsdks/zephyr/soc/intel/intel_adsp/Kconfig.soc"
osource "/Users/naray/nordicsdks/zephyr/soc/intel/elkhart_lake/Kconfig.soc"
osource "/Users/naray/nordicsdks/zephyr/soc/intel/atom/Kconfig.soc"
osource "/Users/naray/nordicsdks/zephyr/soc/intel/apollo_lake/Kconfig.soc"
osource "/Users/naray/nordicsdks/zephyr/soc/intel/alder_lake/Kconfig.soc"
osource "/Users/naray/nordicsdks/zephyr/soc/infineon/cat3/Kconfig.soc"
osource "/Users/naray/nordicsdks/zephyr/soc/infineon/cat1b/Kconfig.soc"
osource "/Users/naray/nordicsdks/zephyr/soc/infineon/cat1a/Kconfig.soc"
osource "/Users/naray/nordicsdks/zephyr/soc/gd/gd32/Kconfig.soc"
osource "/Users/naray/nordicsdks/zephyr/soc/gaisler/leon3/Kconfig.soc"
osource "/Users/naray/nordicsdks/zephyr/soc/gaisler/gr716a/Kconfig.soc"
osource "/Users/naray/nordicsdks/zephyr/soc/espressif/Kconfig.soc"
osource "/Users/naray/nordicsdks/zephyr/soc/ene/kb1200/Kconfig.soc"
osource "/Users/naray/nordicsdks/zephyr/soc/efinix/sapphire/Kconfig.soc"
osource "/Users/naray/nordicsdks/zephyr/soc/cdns/xtensa_sample_controller/Kconfig.soc"
osource "/Users/naray/nordicsdks/zephyr/soc/cdns/sample_controller32/Kconfig.soc"
osource "/Users/naray/nordicsdks/zephyr/soc/cdns/dc233c/Kconfig.soc"
osource "/Users/naray/nordicsdks/zephyr/soc/brcm/bcmvk/Kconfig.soc"
osource "/Users/naray/nordicsdks/zephyr/soc/brcm/bcm2712/Kconfig.soc"
osource "/Users/naray/nordicsdks/zephyr/soc/brcm/bcm2711/Kconfig.soc"
osource "/Users/naray/nordicsdks/zephyr/soc/atmel/sam0/Kconfig.soc"
osource "/Users/naray/nordicsdks/zephyr/soc/atmel/sam/Kconfig.soc"
osource "/Users/naray/nordicsdks/zephyr/soc/aspeed/Kconfig.soc"
osource "/Users/naray/nordicsdks/zephyr/soc/arm/Kconfig.soc"
osource "/Users/naray/nordicsdks/zephyr/soc/arm/beetle/Kconfig.soc"
osource "/Users/naray/nordicsdks/zephyr/soc/andestech/Kconfig.soc"
osource "/Users/naray/nordicsdks/zephyr/soc/amd/acp_6_0/Kconfig.soc"
osource "/Users/naray/nordicsdks/zephyr/soc/ambiq/Kconfig.soc"
osource "/Users/naray/nordicsdks/zephyr/soc/altr/zephyr_nios2f/Kconfig.soc"
osource "/Users/naray/nordicsdks/zephyr/soc/altr/qemu_nios2/Kconfig.soc"
osource "/Users/naray/nordicsdks/zephyr/soc/adi/max32/Kconfig.soc"
osource "/Users/naray/nordicsdks/nrf/soc/nordic/Kconfig.soc"
```

## build/lsm303agr/Kconfig/boards/Kconfig.nrf52833dk
```kconfig
# Load board Kconfig descriptions.
osource "/Users/naray/nordicsdks/zephyr/boards/nordic/nrf52833dk/Kconfig.nrf52833dk"
```
